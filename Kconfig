## boards/shields/avalanche/Kconfig.defconfig
```kconfig
if SHIELD_AVALANCHE_DONGLE

config ZMK_KEYBOARD_NAME
    default "Avalanche"

config ZMK_SPLIT_ROLE_CENTRAL
    default y

config ZMK_SPLIT
    default y

# 2 peripherals: left and right
config ZMK_SPLIT_BLE_CENTRAL_PERIPHERALS
    default 2

# 2 peripherals + 5 BT profiles = 7 connections
config BT_MAX_CONN
    default 7

config BT_MAX_PAIRED
    default 7

if ZMK_DISPLAY

config I2C
    default y

config SSD1306
    default y

endif # ZMK_DISPLAY

if LVGL

config LV_Z_VDB_SIZE
    default 64

config LV_DPI_DEF
    default 149

config LV_Z_BITS_PER_PIXEL
    default 1

choice LV_COLOR_DEPTH
    default LV_COLOR_DEPTH_1
endchoice

endif # LVGL

endif # SHIELD_AVALANCHE_DONGLE

if SHIELD_AVALANCHE_LEFT

config ZMK_KEYBOARD_NAME
    default "Avalanche"

config ZMK_SPLIT_ROLE_CENTRAL
    default y

endif

if SHIELD_AVALANCHE_LEFT || SHIELD_AVALANCHE_RIGHT

config ZMK_SPLIT
    default y

if ZMK_DISPLAY

config I2C
    default y

config SSD1306
    default y

endif # ZMK_DISPLAY

if LVGL

config LV_Z_VDB_SIZE
    default 64

config LV_DPI_DEF
    default 149

config LV_Z_BITS_PER_PIXEL
    default 1

choice LV_COLOR_DEPTH

    default LV_COLOR_DEPTH_1

endchoice

endif # LVGL

endif
```

## config/west.yml
```yaml
manifest:
  remotes:
    - name: zmkfirmware
      url-base: https://github.com/zmkfirmware
    - name: jradm87
      url-base: https://github.com/jradm87
  projects:
    - name: zmk
      remote: zmkfirmware
      revision: v0.3
      import: app/west.yml
    - name: zmk-avalanche
      remote: jradm87
      revision: main
      path: zmk-avalanche
  self:
    path: config
```
